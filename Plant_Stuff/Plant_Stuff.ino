#include <Adafruit_CircuitPlayground.h>
#include <AsyncDelay.h>
#include <Wire.h>
#include <SPI.h>
float midi[127];
int A_four = 440;
const uint8_t spIT[]                PROGMEM ={0x2B,0x19,0xC1,0x99,0x3D,0xDE,0xEC,0xE2,0x14,0x2D,0xBA,0x88,0xE5,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0x00,0x00};
const uint8_t spIS[]                PROGMEM ={0x23,0x6B,0xCE,0x99,0x3B,0x16,0xAF,0xAC,0xDA,0x60,0x9E,0xFC,0xB1,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0x00,0x00};
const uint8_t spFIFTY[]             PROGMEM ={0x0C,0xA8,0x61,0x54,0x02,0x1A,0xF0,0xC0,0x8A,0x73,0x09,0x63,0xB1,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0x8F,0x0F};
const uint8_t spSIXTY[]             PROGMEM ={0x06,0xF8,0x8A,0x5C,0x03,0x0E,0xF8,0xCE,0x44,0x01,0x4F,0x98,0x9D,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0x0A,0xFD};
const uint8_t spSEVENTY[]           PROGMEM ={0x0E,0xF8,0x41,0x38,0x02,0x1E,0xF0,0x80,0x07,0x2C,0xC0,0x81,0x13,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0x03,0x3C};
const uint8_t spEIGHTY[]            PROGMEM ={0x20,0x00,0x2B,0x2D,0x4E,0xD1,0x52,0x32,0x57,0xAC,0x39,0x59,0x4D,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0x00,0x00};
const uint8_t spNINETY[]            PROGMEM ={0xA1,0x73,0x1A,0x3A,0xCA,0x6A,0xE5,0x36,0xB7,0xAB,0x0E,0xB9,0xCA,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0xE3,0x01};
const uint8_t spDEGREES[]           PROGMEM ={0x0A,0x28,0x30,0x6C,0x74,0x53,0x25,0xB3,0x67,0xAC,0x95,0x0D,0x63,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0xFE,0x1F};
AsyncDelay twoSeconds;
int lightVal = 0;
int moistureVal = 0;
float tempVal = 0;
int buttonA = 4;
int slideSwitch = 7;
volatile bool flag = 0;
int switchState = 0;
volatile bool switchFlag = 0;
void speak50(){
  CircuitPlayground.speaker.say(spIT);
  CircuitPlayground.speaker.say(spIS);
  CircuitPlayground.speaker.say(spFIFTY);
  CircuitPlayground.speaker.say(spDEGREES);
  CircuitPlayground.speaker.end();
}
void speak60(){
  CircuitPlayground.speaker.say(spIT);
  CircuitPlayground.speaker.say(spIS);
  CircuitPlayground.speaker.say(spSIXTY);
  CircuitPlayground.speaker.say(spDEGREES);
  CircuitPlayground.speaker.end();
}
void speak70(){
  CircuitPlayground.speaker.say(spIT);
  CircuitPlayground.speaker.say(spIS);
  CircuitPlayground.speaker.say(spSEVENTY);
  CircuitPlayground.speaker.say(spDEGREES);
  CircuitPlayground.speaker.end();
}
void speak80(){
  CircuitPlayground.speaker.say(spIT);
  CircuitPlayground.speaker.say(spIS);
  CircuitPlayground.speaker.say(spEIGHTY);
  CircuitPlayground.speaker.say(spDEGREES);
  CircuitPlayground.speaker.end();
}
void speak90(){
  CircuitPlayground.speaker.say(spIT);
  CircuitPlayground.speaker.say(spIS);
  CircuitPlayground.speaker.say(spNINETY);
  CircuitPlayground.speaker.say(spDEGREES);
  CircuitPlayground.speaker.end();
}
void sparkle(int rVal, int gVal, int bVal){
  for(int i = 0; i < 250; i++){
    int randomPixel = random(0, 10);
    CircuitPlayground.setPixelColor(randomPixel, rVal, gVal, bVal);
    delay(10);
    CircuitPlayground.clearPixels();
    if(flag){
      break;
    }
  }
}
void redAlert(){
  for(int j = 0; j < 255; j++){
    for(int i = 0; i < 10; i++){
      CircuitPlayground.setPixelColor(i, j, 0, 0);
      if(flag){
        break;
      }
    }
  }
}
void allGood(){
  for(int j = 0; j < 255; j++){
    for(int i = 0; i < 10; i++){
      CircuitPlayground.setPixelColor(i, 0, 0, j);
      if(flag){
        break;
      }
    }
  }
}
void generateMIDI(){
  for (int x = 0; x < 127; ++x){
    midi[x] = (A_four / 32.0) * pow(2.0, ((x - 9.0) / 12.0));
    Serial.println(midi[x]);
  }
}
int song[16]{52, 52, 64, 52, 52, 62, 52, 52, 60, 52, 52, 58, 52, 52, 59, 60};


void setup() {
  Serial.begin(9600);
  generateMIDI();
  pinMode(buttonA, INPUT_PULLDOWN);
  pinMode(slideSwitch, INPUT_PULLUP);
  CircuitPlayground.begin();
  attachInterrupt(digitalPinToInterrupt(buttonA), buttonPressed, FALLING);
  attachInterrupt(digitalPinToInterrupt(slideSwitch), switchMoved, CHANGE);
  twoSeconds.start(2000, AsyncDelay::MILLIS);
}

void loop() {
  if(twoSeconds.isExpired()){
    lightVal = CircuitPlayground.lightSensor();
    moistureVal = CircuitPlayground.readCap(6);
    tempVal = CircuitPlayground.temperatureF();
    lightVal = map(lightVal, 0, 1023, 0, 255);
    moistureVal = map(moistureVal, 600, 1020, 50, 400);
    if(lightVal < 0){
      lightVal = 0;
    }
    if(lightVal > 255){
      lightVal = 255;
    }
    if(moistureVal < 50){
      moistureVal = 50;
    }
    if(moistureVal > 400){
      moistureVal = 400;
    }
    Serial.print("Light Value: ");
    Serial.println(lightVal);
    Serial.print("Moisture Value: ");
    Serial.println(moistureVal);
    Serial.print("Temp Value: ");
    Serial.println(tempVal);

  while(!flag){
    if(lightVal < 120){
      sparkle((255-lightVal), 0, 0);
    }
    else{
      sparkle(0, lightVal, 0);
    }
    if(switchFlag){
      delay(5);
      switchState = CircuitPlayground.slideSwitch();
      switchFlag = 0;
    }
    if(!switchState){
      if(tempVal < 50){
        redAlert();
      }
      else if(tempVal < 60){
        speak50();
      }
      else if(tempVal < 70){
        speak60();
      }
      else if(tempVal < 80){
        speak70();
      }
      else if(tempVal < 90){
        speak80();
      }
      else if(tempVal< 100){
        speak90();
      }
      else{
        redAlert();
      }
    }
  }
    flag = 0;
    CircuitPlayground.speaker.set(255);


  if(moistureVal < 200){
    if(switchFlag){
      delay(5);
      switchState = CircuitPlayground.slideSwitch();
      switchFlag = 0; 
      }
    while(!flag){
      redAlert();
      if(!switchState){
        for(int i = 0; i < 16; i++){
          CircuitPlayground.playTone(midi[song[i]], moistureVal);
          delay(moistureVal);
          if(flag){
            break;
          }
        }
      }
    }
  }
  else{
    while(!flag){
      allGood();
      if(!switchState){
        for(int i = 0; i < 16; i++){
          CircuitPlayground.playTone(midi[song[i]], moistureVal);
          delay(moistureVal);
          if(flag){
            break;
          }
        }
      }
    }
  }
  flag = 0;
  CircuitPlayground.clearPixels();
  twoSeconds.restart();
  }
}

void buttonPressed(){
  flag = 1;
}
void switchMoved(){
  switchFlag = 1;
}

void goop(){
  int yay;
}
